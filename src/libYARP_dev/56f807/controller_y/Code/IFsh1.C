/** ###################################################################
**     THIS BEAN MODULE IS GENERATED BY THE TOOL. DO NOT MODIFY IT.
**     Filename  : IFsh1.C
**     Project   : controller_y
**     Processor : 56F807
**     Beantype  : IntFLASH
**     Version   : Bean 02.116, Driver 01.07, CPU db: 2.71.191
**     Compiler  : Metrowerks DSP C Compiler
**     Date/Time : 12/14/2004, 3:14 PM
**     Abstract  :
**         This bean "IntFLASH" implements an access to internal FLASH.
**         The bean support reading/writing data into FLASH, erasing of 
**         selected sector.
**         The bean supports events if the write interrupt is supported.
**         The bean supports following modes of write operations:
**           - Write - writing without any test.
**           - Destructive write - sector is erased if necessary.
**           - Safe write - user event is invoked to save and resore data
**                          from the current sector.
**         The bean requires on-chip FLASH memory (not used/allocated by 
**         other beans).
**     Settings  :
**         FLASH memory type                 : Data FLASH
**         Total Data FLASH memory size      : 8192 words
**         Interrupt service                 : Disabled
**         Write method                      : Destructive write (with erase)
**         Wait in RAM                       : no
**     Contents  :
**         SetByteFlash - byte IFsh1_SetByteFlash(dword Addr,byte Data);
**         SetWordFlash - byte IFsh1_SetWordFlash(dword Addr,word Data);
**         GetWordFlash - byte IFsh1_GetWordFlash(dword Addr,word *Data);
**         SetLongFlash - byte IFsh1_SetLongFlash(dword Addr,dword Data);
**         GetLongFlash - byte IFsh1_GetLongFlash(dword Addr,dword *Data);
**
**     (c) Copyright UNIS, spol. s r.o. 1997-2002
**     UNIS, spol. s r.o.
**     Jundrovska 33
**     624 00 Brno
**     Czech Republic
**     http      : www.processorexpert.com
**     mail      : info@processorexpert.com
** ###################################################################*/
/* MODULE IFsh1. */

#include "IFsh1.h"

static volatile byte Err;              /* Error state of a current process */
/*
** ===================================================================
**     Method      :  IFsh1_OutOfRange (bean IntFLASH)
**
**     Description :
**         This method is internal. It is used by Processor Expert
**         only.
** ===================================================================
*/
static byte OutOfRange(dword addr1,dword addr2)
{
  return ((addr1>addr2)||(addr1<DataFlashStart)||(addr2>DataFlashEnd));
}

/*
** ===================================================================
**     Method      :  IFsh1_SectorSize (bean IntFLASH)
**
**     Description :
**         This method is internal. It is used by Processor Expert
**         only.
** ===================================================================
*/
#define SectorSize(addr) (256)

/*
** ===================================================================
**     Method      :  ClearFlags (bean IntFLASH)
**
**     Description :
**         This method is internal. It is used by Processor Expert
**         only.
** ===================================================================
*/
#define ClearFlags() setReg(DFIU_IS,0)

/*
** ===================================================================
**     Method      :  AccessError (bean IntFLASH)
**
**     Description :
**         This method is internal. It is used by Processor Expert
**         only.
** ===================================================================
*/
#define AccessError() (getReg(DFIU_IS) & 0x0c03)

/*
** ===================================================================
**     Method      :  readflash (bean IntFLASH)
**
**     Description :
**         This method is internal. It is used by Processor Expert
**         only.
** ===================================================================
*/
#define readflash(address) (*(word *)(address))

/*
** ===================================================================
**     Method      :  writeflash (bean IntFLASH)
**
**     Description :
**         This method is internal. It is used by Processor Expert
**         only.
** ===================================================================
*/
#define writeflash(address, data) (*(word *)(address)=data)

/*
** ===================================================================
**     Method      :  procflash (bean IntFLASH)
**
**     Description :
**         This method is internal. It is used by Processor Expert
**         only.
** ===================================================================
*/
static byte procflash(word address, word data, word command)
{
  if (getRegBit(DFIU_CNTL,BUSY)==1)    /* Is DFIU busy ? */
    return ERR_BUSY;                   /* If yes then error */
  ClearFlags();                        /* Clear all flags */
  setReg(DFIU_CNTL,0);                 /* Reset DFIU_CNTL register */
  EnterCritical();                     /* Disable all low level interrupts */
  if (command==PROGRAM) {
    setReg(DFIU_EE, 0);                /* Clear Erase enable register */
    setReg(DFIU_PE,(address>>5)+0x4000); /* Write row number and enable intelligent programming */
  }
  else {
    setReg(DFIU_PE, 0);                /* Clear Program enable register */
    if (command==MASS_ERASE){          /* Is the mass erase operation requested? */
      setReg(DFIU_EE,0x4000);          /* Write page number and enable intelligent erase */
      setRegBit(DFIU_CNTL,MAS1);       /* If yes, then enable mass erase */
    }
    else
      setReg(DFIU_EE,(address>>8)+0x4000); /* Write page number and enable intelligent erase */
  }
  writeflash(address,data);            /* Write data to program memory - launch the operation */
  ExitCritical();                      /* Enable all low level interrupts */
  if (AccessError())                   /* Is an access error detected ? */
    return ERR_NOTAVAIL;               /* If yes then return the error */
  return Err;
}

/*
** ===================================================================
**     Method      :  WriteWords (bean IntFLASH)
**
**     Description :
**         This method is internal. It is used by Processor Expert
**         only.
** ===================================================================
*/
static byte WriteWords(word Addr, word* PData, word Size)
{
  register unsigned int i;
  register unsigned int j,cycles, AddrInSec;
  Err = ERR_OK;
  if (OutOfRange(Addr,Addr+Size-1))    /* Is the address out of range? */
    return(ERR_RANGE);                 /* If yes then exit */
  for(i=0; i<Size; i++) {              /* For all given data */
    AddrInSec = (Addr+i)&(SectorSize(Addr+i)-1); /* Calculate relative address in a sector */
    if ((AddrInSec==0)||(i==0)) {      /* Is the actual address the first or is it a border of a sector? */
      cycles = SectorSize(Addr+i)-(AddrInSec)- /* How many address places have to be testet in the actual sector? */
               (((Size-i<(SectorSize(Addr+i))-AddrInSec))?(SectorSize(Addr+1)-AddrInSec-Size+i):0);
      while (getRegBit(DFIU_CNTL,BUSY) != 0){} /* Wait to command complete */
      for(j=0; j<cycles;j++) {         /* For all memory locations which have to be tested in the actual sector */
        if (~(readflash(Addr+i+j))&(PData[i+j])) { /* Is the sector erasure necessary? */
          Err = procflash((Addr+i),0,PAGE_ERASE); /* Erase the sector */
          if (Err != ERR_OK)           /* If an error occured then exit */
            return Err;
          break;                       /* The sector is backuped and erased. Now end test of the sector */
        }
      }
    }
    while (getRegBit(DFIU_CNTL,BUSY) != 0){} /* Wait to command complete */
    Err = procflash((Addr+i), PData[i], PROGRAM); /* Write new data to Flash */
    if (Err!=ERR_OK)                   /* If an error occured then exit */
      return Err;
  }
  while (getRegBit(DFIU_CNTL,BUSY) != 0){} /* Wait to command complete */
  setReg(DFIU_PE,0);                   /* Clear program enable register - stop programming */
  for(i=0; i<Size; i++)                /* Check all given data were written good */
    if (readflash(Addr+i)!=PData[i])
      return ERR_VALUE;                /* If an error occured exit */
  return Err;
}

/*
** ===================================================================
**     Method      :  IFsh1_SetByteFlash (bean IntFLASH)
**
**     Description :
**         Write byte to address in FLASH.
**     Parameters  :
**         NAME            - DESCRIPTION
**         Addr            - Address to FLASH. In case of Motorola
**                           56800 derivates the address is an
**                           address of the accordant WORD16 location
**                           multiplied by two and LSB is zero for
**                           accessing a lower byte and LSB is one
**                           for accessing a higher byte.
**         Data            - Data to write.
**     Returns     :
**         ---             - Error code, possible codes:
**                           - ERR_OK - OK
**                           - ERR_NOTAVAIL - Desired program/erase
**                           operation is not available
**                           - ERR_RANGE - Address is out of range
**                           - ERR_VALUE - Read value is not equal to
**                           written value
**                           - ERR_SPEED - This device does not work
**                           in the active speed mode
** ===================================================================
*/
byte IFsh1_SetByteFlash(dword Addr,byte Data)
{
  word Data16;
  byte rot;
  rot = (Addr%2)*8;
  Data16 = (readflash(Addr/2)&(0xff00>>rot))+((Data&0xff)<<rot);
  return WriteWords(Addr/2, &Data16, sizeof(Data16)/sizeof(word)); /* Write data to FLASH - use block method */
}

/*
** ===================================================================
**     Method      :  IFsh1_SetWordFlash (bean IntFLASH)
**
**     Description :
**         Write word to address in FLASH.
**     Parameters  :
**         NAME            - DESCRIPTION
**         Addr            - Address to FLASH.
**         Data            - Data to write.
**     Returns     :
**         ---             - Error code, possible codes:
**                           - ERR_OK - OK
**                           - ERR_NOTAVAIL - Desired program/erase
**                           operation is not available
**                           - ERR_RANGE - Address is out of range
**                           - ERR_VALUE - Read value is not equal to
**                           written value
**                           - ERR_SPEED - This device does not work
**                           in the active speed mode
** ===================================================================
*/
byte IFsh1_SetWordFlash(dword Addr,word Data)
{
  return WriteWords(Addr, &Data, sizeof(Data)/sizeof(word)); /* Write data to FLASH - use block method */
}

/*
** ===================================================================
**     Method      :  IFsh1_GetWordFlash (bean IntFLASH)
**
**     Description :
**         Method gets word from address in FLASH
**     Parameters  :
**         NAME            - DESCRIPTION
**         Addr            - Address to FLASH
**       * Data            - Pointer to returned 16-bit data
**     Returns     :
**         ---             - Error code
** ===================================================================
*/
byte IFsh1_GetWordFlash(dword Addr,word *Data)
{
  if (OutOfRange(Addr,Addr))           /* Check range of address */
    return ERR_RANGE;
  *Data = readflash(Addr);             /* read data from FLASH */
  return ERR_OK;
}

/*
** ===================================================================
**     Method      :  IFsh1_SetLongFlash (bean IntFLASH)
**
**     Description :
**         Write long word to address in FLASH.
**     Parameters  :
**         NAME            - DESCRIPTION
**         Addr            - Address to FLASH.
**         Data            - Data to write.
**     Returns     :
**         ---             - Error code, possible codes:
**                           - ERR_OK - OK
**                           - ERR_NOTAVAIL - Desired program/erase
**                           operation is not available
**                           - ERR_RANGE - Address is out of range
**                           - ERR_VALUE - Read value is not equal to
**                           written value
**                           - ERR_SPEED - This device does not work
**                           in the active speed mode
** ===================================================================
*/
byte IFsh1_SetLongFlash(dword Addr,dword Data)
{
  return WriteWords(Addr, (word *)&Data, sizeof(Data)/sizeof(word)); /* Write data to FLASH - use block method */
}

/*
** ===================================================================
**     Method      :  IFsh1_GetLongFlash (bean IntFLASH)
**
**     Description :
**         Get long word from address in FLASH.
**     Parameters  :
**         NAME            - DESCRIPTION
**         Addr            - Address to FLASH.
**       * Data            - Pointer to returned 32-bit data.
**     Returns     :
**         ---             - Error code, possible codes:
**                           - ERR_OK - OK
**                           - ERR_RANGE - Address is out of range
** ===================================================================
*/
byte IFsh1_GetLongFlash(dword Addr,dword *Data)
{
  if (OutOfRange(Addr+1,Addr+1))       /* Check range of address */
    return ERR_RANGE;
  *Data = readflash(Addr) + (((dword)(readflash(Addr+1)))<<16); /* Read data from FLASH */
  return ERR_OK;
}

/* END IFsh1. */


/*
** ###################################################################
**
**     This file was created by UNIS Processor Expert 03.32 for 
**     the Motorola 56800 series of microcontrollers.
**
** ###################################################################
*/
