/** ###################################################################
**     THIS BEAN MODULE IS GENERATED BY THE TOOL. DO NOT MODIFY IT.
**     Filename  : AS1.C
**     Project   : controller_y
**     Processor : 56F807
**     Beantype  : AsynchroSerial
**     Version   : Bean 02.231, Driver 01.03, CPU db: 2.71.191
**     Compiler  : Metrowerks DSP C Compiler
**     Date/Time : 12/14/2004, 2:54 PM
**     Abstract  :
**         This bean "AsynchroSerial" implements an asynchronous serial
**         communication. The bean supports different settings of 
**         parity, word width, stop-bit and communication speed,
**         user can select interrupt or polling handler.
**         Communication speed can be changed also in runtime.
**         The bean requires one on-chip asynchronous serial channel.
**     Settings  :
**         Serial channel              : SCI0
**
**         Protocol
**             Init baud rate          : 115200baud
**             Width                   : 8 bits
**             Stop bits               : 1
**             Parity                  : none
**             Breaks                  : Disabled
**
**         Registers
**             Input buffer            : SCI0_SCIDR [4867]
**             Output buffer           : SCI0_SCIDR [4867]
**             Control register        : SCI0_SCICR [4865]
**             Mode register           : SCI0_SCICR [4865]
**             Baud setting reg.       : SCI0_SCIBR [4864]
**
**
**
**         Used pins                   : 
**             ----------------------------------------------------
**               Function | On package |    Name
**             ----------------------------------------------------
**                Input   |     160    |  GPIOE1_RXD0
**                Output  |     159    |  GPIOE0_TXD0
**             ----------------------------------------------------
**
**
**     Contents  :
**         RecvChar        - byte AS1_RecvChar(AS1_TComData *Chr);
**         SendChar        - byte AS1_SendChar(AS1_TComData Chr);
**         GetCharsInRxBuf - word AS1_GetCharsInRxBuf(void);
**         GetCharsInTxBuf - word AS1_GetCharsInTxBuf(void);
**
**     (c) Copyright UNIS, spol. s r.o. 1997-2002
**     UNIS, spol. s r.o.
**     Jundrovska 33
**     624 00 Brno
**     Czech Republic
**     http      : www.processorexpert.com
**     mail      : info@processorexpert.com
** ###################################################################*/

/* MODULE AS1. */

#include "AS1.h"


#define OVERRUN_ERR      1             /* Overrun error flag bit   */
#define FRAMING_ERR      2             /* Framing error flag bit   */
#define PARITY_ERR       4             /* Parity error flag bit    */
#define CHAR_IN_RX       8             /* Char is in RX buffer     */
#define FULL_TX          16            /* Full transmit buffer     */
#define RUNINT_FROM_TX   32            /* Interrupt is in progress */
#define FULL_RX          64            /* Full receive buffer      */
#define NOISE_ERR        128           /* Noise erorr flag bit     */
#define IDLE_ERR         256           /* Idle character flag bit  */
#define BREAK_ERR        512           /* Break detect             */

static word SerFlag;                   /* Flags for serial communication */
                                       /* Bits: 0 - OverRun error */
                                       /*       1 - Framing error */
                                       /*       2 - Parity error */
                                       /*       3 - Char in RX buffer */
                                       /*       4 - Full TX buffer */
                                       /*       5 - Unused */
                                       /*       6 - Full RX buffer */
                                       /*       7 - Noise error */
                                       /*       8 - Idle character  */
                                       /*       9 - Break detected  */
                                       /*      10 - Unused */


/*
** ===================================================================
**     Method      :  HWEnDi (bean AsynchroSerial)
**
**     Description :
**         This method is internal. It is used by Processor Expert
**         only.
** ===================================================================
*/
static void HWEnDi(void)
{
  setRegBits(SCI0_SCICR, (SCI0_SCICR_TE_MASK | SCI0_SCICR_RE_MASK)); /* Enable device */
}

/*
** ===================================================================
**     Method      :  AS1_RecvChar (bean AsynchroSerial)
**
**     Description :
**         If any data received, this method returns one character,
**         otherwise it returns error code (it does not wait for
**         data). This method is enabled only if the receiver
**         property is enabled.
**     Parameters  :
**         NAME            - DESCRIPTION
**       * Chr             - Pointer to received character
**     Returns     :
**         ---             - Error code, possible codes:
**                           ERR_OK - OK
**                           ERR_SPEED - This device does not work in
**                           the active speed mode
**                           ERR_RXEMPTY - No data in receiver
**                           ERR_OVERRUN - Overrun error is detected
**                           ERR_FRAMING - Framing error is detected
**                           ERR_PARITY - Parity error is detected
**                           ERR_BREAK - Break character is detected
**                           ERR_IDLE - Idle character is detected
**                           (this error is hardware specific).
** ===================================================================
*/
byte AS1_RecvChar(AS1_TComData *Chr)
{
  register byte Result = ERR_OK;       /* Return error code */

  if (getReg(SCI0_SCISR) & 24320) {    /* Is any error flag set? */
    if (getRegBit(SCI0_SCISR, RIDLE) || getRegBit(SCI0_SCISR, TIDLE))
      SerFlag |= IDLE_ERR;             /* Idle character flag */
    if (getRegBit(SCI0_SCISR, PF))
      SerFlag |= PARITY_ERR;           /* Parity error flag */
    if (getRegBit(SCI0_SCISR, NF))
      SerFlag |= NOISE_ERR;            /* Noise error flag */
    if (getRegBit(SCI0_SCISR, OR))
      SerFlag |= OVERRUN_ERR;          /* Overrun error flag */
    if (getRegBit(SCI0_SCISR, FE))
      SerFlag |= FRAMING_ERR;          /* Framming error flag */
    setReg(SCI0_SCISR, 0);             /* Reset error request flags */
  }
  if (!getRegBit(SCI0_SCISR, RDRF))    /* Is the reciver empty? */
    return ERR_RXEMPTY;                /* If yes then error */
  *Chr = getReg(SCI0_SCIDR);           /* Read data from the receiver */
  if (SerFlag & (OVERRUN_ERR|FRAMING_ERR|PARITY_ERR|NOISE_ERR|FULL_RX)) { /* Is any error flag set? */
    if ((SerFlag & OVERRUN_ERR) != 0)  /* Is the overrun error detected? */
      Result = ERR_OVERRUN;            /* If yes then set the overrun error flag */
    else if ((SerFlag & PARITY_ERR) != 0) /* Is the parity error detected? */
      Result = ERR_PARITY;             /* If yes then set the parity error flag */
    else if ((SerFlag & FRAMING_ERR) != 0) /* Is the framing error detected? */
      Result = ERR_FRAMING;            /* If yes then set the framing error flag */
    else if ((SerFlag & NOISE_ERR) != 0) /* Is the noise error detected? */
      Result = ERR_NOISE;              /* If yes then set the noise error flag */
    SerFlag &= ~(OVERRUN_ERR|FRAMING_ERR|PARITY_ERR|NOISE_ERR); /* Clear all errors in the status variable */
  }
  return Result;                       /* Return error code */
}

/*
** ===================================================================
**     Method      :  AS1_SendChar (bean AsynchroSerial)
**
**     Description :
**         Send one character to the channel. This method is
**         available only if the transmitter property is enabled.
**     Parameters  :
**         NAME            - DESCRIPTION
**         Chr             - Character to send
**     Returns     :
**         ---             - Error code, possible codes:
**                           ERR_OK - OK
**                           ERR_SPEED - This device does not work in
**                           the active speed mode
**                           ERR_TXFULL - Transmitter is full
** ===================================================================
*/
byte AS1_SendChar(AS1_TComData Chr)
{
  if (!getRegBit(SCI0_SCISR, TDRE))    /* Is the transmitter empty? */
    return ERR_TXFULL;                 /* If yes then error */
  setReg(SCI0_SCIDR, Chr);             /* Store char to transmitter register */
  return ERR_OK;                       /* OK */
}

/*
** ===================================================================
**     Method      :  AS1_GetCharsInRxBuf (bean AsynchroSerial)
**
**     Description :
**         Return number of characters in the input buffer. This
**         method is available only if the receiver property is
**         enabled.
**     Parameters  : None
**     Returns     :
**         ---             - Number of characters in the input
**                           buffer.
** ===================================================================
*/
word AS1_GetCharsInRxBuf(void)
{
  return (getRegBit(SCI0_SCISR, RDRF) != 0)? 1:0; /* Return number of chars in receive buffer */
}

/*
** ===================================================================
**     Method      :  AS1_GetCharsInTxBuf (bean AsynchroSerial)
**
**     Description :
**         Return number of characters in the output buffer. This
**         method is available only if the transmitter property is
**         enabled.
**     Parameters  : None
**     Returns     :
**         ---             - Number of characters in the output
**                           buffer.
** ===================================================================
*/
word AS1_GetCharsInTxBuf(void)
{
  return (getRegBit(SCI0_SCISR, TDRE) == 0)? 1:0; /* Return number of chars in the transmitter buffer */
}

/*
** ===================================================================
**     Method      :  AS1_Init (bean AsynchroSerial)
**
**     Description :
**         This method is internal. It is used by Processor Expert
**         only.
** ===================================================================
*/
void AS1_Init(void)
{
  SerFlag = 0;                         /* Reset flags */
  /* SCI0_SCICR: LOOP=0,SWAI=0,RSRC=0,M=0,WAKE=0,POL=0,PE=0,PT=0,TEIE=0,TIIE=0,RIE=0,REIE=0,TE=0,RE=0,RWU=0,SBK=0 */
  setReg(SCI0_SCICR, 0);               /* Set the SCI configuration */
  setReg(SCI0_SCIBR, 22);              /* Set prescaler bits */
  HWEnDi();                            /* Enable/disable device according to status flags */
}


/* END AS1. */


/*
** ###################################################################
**
**     This file was created by UNIS Processor Expert 03.32 for 
**     the Motorola 56800 series of microcontrollers.
**
** ###################################################################
*/
